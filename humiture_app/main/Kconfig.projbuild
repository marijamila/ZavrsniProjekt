## humiture_app/main/Kconfig.projbuild
```kconfig
menu "Project Configuration"

    menu "I2C Master"
        config I2C_MASTER_SCL
            int "SCL GPIO Num"
            default 2
            help
                GPIO number for I2C Master clock line.

        config I2C_MASTER_SDA
            int "SDA GPIO Num"
            default 3
            help
                GPIO number for I2C Master data line.

        config I2C_MASTER_PORT_NUM
            int "Port Number"
            default 1 if IDF_TARGET_ESP32 || IDF_TARGET_ESP32S2 || IDF_TARGET_ESP32S3
            default 0 if IDF_TARGET_ESP32C3 || IDF_TARGET_ESP32C2 || IDF_TARGET_ESP32H2
            help
                Port number for I2C Master device.
    endmenu

    menu "SHTC3 Sensor"
        
        choice SHTC3_MODE
            prompt "SHTC3 Operation Mode"
            default SHTC3_MEAS_T_RH_CLOCKSTR_EN
            help
                Operation Mode of SHTC3.
            config SHTC3_MEAS_T_RH_CLOCKSTR_EN
                bool "Clock stretching enabled, read temperature first"
            config SHTC3_MEAS_RH_T_CLOCKSTR_EN
                bool "Clock stretching enabled, read humidity first"
            config SHTC3_MEAS_T_RH_CLOCKSTR_DIS
                bool "Clock stretching disabled, read temperature first"
            config SHTC3_MEAS_RH_T_CLOCKSTR_DIS
                bool "Clock stretching disabled, read humidity first"
        endchoice

        config SHTC3_MODE
            hex
            default 0x7CA2 if SHTC3_MEAS_T_RH_CLOCKSTR_EN
            default 0x5C24 if SHTC3_MEAS_RH_T_CLOCKSTR_EN
            default 0x7866 if SHTC3_MEAS_T_RH_CLOCKSTR_DIS
            default 0x58E0 if SHTC3_MEAS_RH_T_CLOCKSTR_DIS

    endmenu


    menu "Power Management Configuration"

        config WIFI_SSID
            string "WiFi SSID"
            default "myssid"
            help
                SSID (network name) for the example to connect to.
    
        config WIFI_PASSWORD
            string "WiFi Password"
            default "mypassword"
            help
                WiFi password (WPA or WPA2) for the example to use.
    

        config WIFI_LISTEN_INTERVAL
            int "WiFi listen interval"
            default 3
            help
                Interval for station to listen to beacon from AP. The unit of listen interval is one beacon interval.
                For example, if beacon interval is 100 ms and listen interval is 3, the interval for station to listen
                to beacon is 300 ms.

        config WIFI_BEACON_TIMEOUT
            int "WiFi beacon timeout"
            default 6
            range 6 30
            help
                For Station, If the station does not receive a beacon frame from the connected SoftAP during the
                inactive time, disconnect from SoftAP. Default 6s.

        choice POWER_SAVE_MODE
            prompt "power save mode"
            default POWER_SAVE_MIN_MODEM
            help
                Power save mode for the esp32 to use. Modem sleep mode includes minimum and maximum power save modes.
                In minimum power save mode, station wakes up every DTIM to receive beacon. Broadcast data will not be
                lost because it is transmitted after DTIM. However, it can not save much more power if DTIM is short
                for DTIM is determined by AP.
                In maximum power save mode, station wakes up every listen interval to receive beacon. Broadcast data
                may be lost because station may be in sleep state at DTIM time. If listen interval is longer, more power
                is saved but broadcast data is more easy to lose.

            config POWER_SAVE_NONE
                bool "none"
            config POWER_SAVE_MIN_MODEM
                bool "minimum modem"
            config POWER_SAVE_MAX_MODEM
                bool "maximum modem"
        endchoice

        choice MAX_CPU_FREQ
            prompt "Maximum CPU frequency"
            default MAX_CPU_FREQ_80
            depends on PM_ENABLE
            help
                Maximum CPU frequency to use for dynamic frequency scaling.

            config MAX_CPU_FREQ_80
                bool "80 MHz"
            config MAX_CPU_FREQ_120
                bool "120 MHz"
                depends on IDF_TARGET_ESP32C2
            config MAX_CPU_FREQ_160
                bool "160 MHz"
                depends on !IDF_TARGET_ESP32C2
            config MAX_CPU_FREQ_240
                bool "240 MHz"
                depends on IDF_TARGET_ESP32 || IDF_TARGET_ESP32S2 || IDF_TARGET_ESP32S3
        endchoice

        config MAX_CPU_FREQ_MHZ
            int
            default 80 if MAX_CPU_FREQ_80
            default 120 if MAX_CPU_FREQ_120
            default 160 if MAX_CPU_FREQ_160
            default 240 if MAX_CPU_FREQ_240

        choice MIN_CPU_FREQ
            prompt "Minimum CPU frequency"
            default MIN_CPU_FREQ_10M
            depends on PM_ENABLE
            help
                Minimum CPU frequency to use for dynamic frequency scaling.
                Should be set to XTAL frequency or XTAL frequency divided by integer.

            config MIN_CPU_FREQ_40M
                bool "40 MHz (use with 40MHz XTAL)"
                depends on XTAL_FREQ_40 || XTAL_FREQ_AUTO
            config MIN_CPU_FREQ_20M
                bool "20 MHz (use with 40MHz XTAL)"
                depends on XTAL_FREQ_40 || XTAL_FREQ_AUTO
            config MIN_CPU_FREQ_10M
                bool "10 MHz (use with 40MHz XTAL)"
                depends on XTAL_FREQ_40 || XTAL_FREQ_AUTO
            config MIN_CPU_FREQ_26M
                bool "26 MHz (use with 26MHz XTAL)"
                depends on XTAL_FREQ_26 || XTAL_FREQ_AUTO
            config MIN_CPU_FREQ_13M
                bool "13 MHz (use with 26MHz XTAL)"
                depends on XTAL_FREQ_26 || XTAL_FREQ_AUTO
        endchoice

        config MIN_CPU_FREQ_MHZ
            int
            default 40 if MIN_CPU_FREQ_40M
            default 20 if MIN_CPU_FREQ_20M
            default 10 if MIN_CPU_FREQ_10M
            default 26 if MIN_CPU_FREQ_26M
            default 13 if MIN_CPU_FREQ_13M

    endmenu

endmenu
```
